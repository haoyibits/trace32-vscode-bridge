; ------------------------------------------------------------------------------
; PowerView startup script for trace32_auto.
;
; Started by scripts/t32.sh as:
;   <t32-binary> -c <config.t32> -s <this script> <toolkit-root>
;
; It only loads the generated configuration and installs the toolbar. Flashing
; and symbol loading are driven afterwards over RCL by target.cmm.
; ------------------------------------------------------------------------------

PRIVATE &root
ENTRY %LINE &root
&root=STRing.TRIM("&root")

IF "&root"==""
  &root=OS.ENV(T32AUTO_DIR)

IF "&root"==""
(
  PRINT %ERROR "trace32_auto: startup.cmm needs the toolkit root as argument"
  ENDDO
)

DO "&root/scripts/load_config.cmm" &root

DO "&CFG_ROOT/scripts/toolbar.cmm"

PRINT "trace32_auto ready (&CFG_PROGRAM)"

; t32.sh waits for this stamp before sending the first RCL command.
OPEN #1 "&CFG_RUNDIR/ready" /Create
WRITE #1 "OK"
CLOSE #1

ENDDO
