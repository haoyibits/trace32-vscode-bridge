; ------------------------------------------------------------------------------
; Flash and/or attach the configured image.
;
; Usage:
;   DO scripts/target.cmm ACTION=flash [ROOT=<toolkit-root>]
;       erase + program + symbols + run
;   DO scripts/target.cmm ACTION=load  [ROOT=<toolkit-root>]
;       symbols only, target keeps running
;
; Everything else comes from config.env through .run/config.cmm.
;
; The script writes .run/done when it finishes so that t32.sh can block on it:
; t32rem returns as soon as a command is queued, not when it completes.
; ------------------------------------------------------------------------------

PRIVATE &parameters &action &root
ENTRY %LINE &parameters

&action=STRing.LoWeR(STRing.SCANAndExtract("&parameters","ACTION=","load"))
&root=STRing.SCANAndExtract("&parameters","ROOT=","")

IF "&root"!=""
  DO "&root/scripts/load_config.cmm" &root
ELSE
  DO "~~~~/load_config.cmm"

; From here on &CFG_RUNDIR is known, so any TRACE32 error can be reported back
; to t32.sh instead of leaving it to time out.
ON ERROR GOSUB
(
  GOSUB Done "FAIL: TRACE32 error, see the PowerView AREA window"
  ENDDO
)

IF ("&action"!="flash")&&("&action"!="load")
(
  GOSUB Done "FAIL: unknown ACTION '&action' (use flash or load)"
  ENDDO
)

IF !OS.FILE("&CFG_ELF")
(
  GOSUB Done "FAIL: ELF not found: &CFG_ELF"
  ENDDO
)

IF "&action"=="flash"
(
  IF "&CFG_FLASH_SCRIPT"==""
  (
    GOSUB Done "FAIL: T32_FLASH_SCRIPT is empty in config.env"
    ENDDO
  )
  IF !OS.FILE("&CFG_FLASH_SCRIPT")
  (
    GOSUB Done "FAIL: flash script not found: &CFG_FLASH_SCRIPT"
    ENDDO
  )
  GOSUB Program
)

GOSUB SetupDebug

GOSUB Done "OK"
ENDDO


; ------------------------------------------------------------------------------
; Erase and program the ELF.
;
; PREPAREONLY is Lauterbach's convention for "connect, set up the target and
; declare the flash, but do not program anything" - roughly 770 of the 839
; scripts under ~~/demo/arm/flash implement it, and the other architectures
; likewise. Everything after that declaration is identical for every device,
; which is what makes T32_FLASH_SCRIPT a genuine one-line switch.
Program:
(
  DO "&CFG_FLASH_SCRIPT" PREPAREONLY &CFG_FLASH_ARGS

  ; Apply the configured clock to the programming run itself, whatever default
  ; the device script picked.
  IF "&CFG_JTAG_CLOCK"!=""
    SYStem.JtagClock &CFG_JTAG_CLOCK

  FLASH.ReProgram ALL /Erase
  Data.LOAD.Elf "&CFG_ELF"
  FLASH.ReProgram OFF

  ; Reset the device so it boots the image that was just programmed.
  SYStem.Down
  SYStem.Up

  IF "&CFG_JTAG_CLOCK"!=""
    SYStem.JtagClock &CFG_JTAG_CLOCK

  ; Keep interrupts from being taken while single-stepping.
  SYStem.Option.IMASKASM ON
  SYStem.Option.IMASKHLL ON

  PRINT "trace32-vscode-bridge: flashed &CFG_ELF"
  RETURN
)


; ------------------------------------------------------------------------------
SetupDebug:
(
  ; Each of these is optional because not every architecture has the command:
  ; TriCore, for instance, has no SYStem.MemAccess at all. Leaving the matching
  ; key empty in config.env skips the line.
  IF !SYStem.Up()
  (
    SYStem.Mode Down
    IF "&CFG_CPU"!=""
      SYStem.CPU &CFG_CPU
    IF "&CFG_MEMACCESS"!=""
      SYStem.MemAccess &CFG_MEMACCESS
    IF "&CFG_CORES"!=""
      CORE.ASSIGN &CFG_CORES
    SYStem.Mode Attach
  )

  ; Symbols only: never overwrite what is already running on the target.
  Data.LOAD.Elf "&CFG_ELF" /NoCODE

  ; Run-time memory access, required by the RTT viewer while the core runs.
  IF "&CFG_DUALPORT"!=""
    SYStem.Option.DUALPORT &CFG_DUALPORT

  List.auto

  IF !STATE.RUN()
    Go

  PRINT "trace32-vscode-bridge: symbols loaded for &CFG_PROGRAM"
  RETURN
)


; ------------------------------------------------------------------------------
Done:
(
  PARAMETERS &status
  OPEN #1 "&CFG_RUNDIR/done" /Create
  WRITE #1 "&status"
  CLOSE #1
  IF STRing.SCAN("&status","FAIL",0)==0
    PRINT %ERROR "trace32-vscode-bridge: &status"
  RETURN
)
