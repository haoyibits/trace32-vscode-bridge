; ------------------------------------------------------------------------------
; Two extra toolbar buttons, mirroring the VS Code tasks so the same flows are
; reachable from PowerView itself. The stock TRACE32 menu and toolbar are left
; untouched.
; ------------------------------------------------------------------------------

MENU.ReProgram
(
  ADD
  TOOLBAR
  (
    SEPARATOR
    TOOLITEM "Flash"    "FL" "DO &CFG_ROOT/scripts/target.cmm ACTION=flash ROOT=&CFG_ROOT"
    TOOLITEM "Load ELF" "LD" "DO &CFG_ROOT/scripts/target.cmm ACTION=load ROOT=&CFG_ROOT"
  )
)

ENDDO
